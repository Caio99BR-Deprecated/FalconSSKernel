/*
 * Copyright (c) 2013, The Linux Foundation. All rights reserved.
 *
 * This program is free software; you can redistribute it and/or modify
 * it under the terms of the GNU General Public License version 2 and
 * only version 2 as published by the Free Software Foundation.
 *
 * This program is distributed in the hope that it will be useful,
 * but WITHOUT ANY WARRANTY; without even the implied warranty of
 * MERCHANTABILITY or FITNESS FOR A PARTICULAR PURPOSE.  See the
 * GNU General Public License for more details.
 */

&i2c {
	qcom,camera@78 {
		compatible = "qcom,s5k5ca";
		reg = <0x78>;
		qcom,slave-id = <0x78 0x0f12 0x05ca>;
		qcom,csiphy-sd-index = <0>;
		qcom,csid-sd-index = <0>;
		qcom,mount-angle = <90>;
		qcom,sensor-name = "s5k5ca";
		cam_vdig-supply = <&pm8110_l2>;
		cam_vana-supply = <&pm8110_l19>;
		cam_vio-supply = <&pm8110_l14>;
		qcom,cam-vreg-name = "cam_vdig", "cam_vio", "cam_vana";
		qcom,cam-vreg-type = <0 0 0>;
		qcom,cam-vreg-min-voltage = <1200000 1800000 2850000>;
		qcom,cam-vreg-max-voltage = <1200000 1800000 2850000>;
		qcom,cam-vreg-op-mode = <200000 80000 80000>;
		qcom,gpio-no-mux = <0>;
		gpios = <&msmgpio 8 0>,
			<&msmgpio 9 0>,
			<&msmgpio 13 0>,
			<&msmgpio 21 0>,
			<&msmgpio 84 0>,
			<&msmgpio 85 0>;
		qcom,gpio-reset = <4>;
		qcom,gpio-standby = <5>;
		qcom,gpio-req-tbl-num = <0 1 2 3 4 5>;
		qcom,gpio-req-tbl-flags = <1 1 1 1 1 1>;
		qcom,gpio-req-tbl-label = "CAMIF_MCLK",
					  "CAM_1V8_EN",
					  "CAM_2V8_EN",
					  "CAM_RESET",
					  "CAM_ID",
					  "CAM_STANDBY";
		qcom,gpio-set-tbl-num = <1 1>;
		qcom,gpio-set-tbl-flags = <0 2>;
		qcom,gpio-set-tbl-delay = <1000 4000>;
		qcom,csi-lane-assign = <0xe4>;
		qcom,csi-lane-mask = <0x3>;
		qcom,sensor-position = <0>;
		qcom,sensor-mode = <0>;
		qcom,cci-master = <0>;
	};
};
