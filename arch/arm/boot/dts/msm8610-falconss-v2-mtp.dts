/* Copyright (c) 2013, The Linux Foundation. All rights reserved.
 *
 * This program is free software; you can redistribute it and/or modify
 * it under the terms of the GNU General Public License version 2 and
 * only version 2 as published by the Free Software Foundation.
 *
 * This program is distributed in the hope that it will be useful,
 * but WITHOUT ANY WARRANTY; without even the implied warranty of
 * MERCHANTABILITY or FITNESS FOR A PARTICULAR PURPOSE.  See the
 * GNU General Public License for more details.
 */

/dts-v1/;

/include/ "msm8610-falconss-v2.dtsi"
/include/ "msm8610-falconss-mtp.dtsi"
/include/ "dsi-v2-panel-hx8379a-wvga-video-falconss.dtsi"
/include/ "msm8610-falconss-camera-sensor-cdp-mtp.dtsi"

/ {
	model = "Qualcomm MSM 8610v2 MTP";
	compatible = "qcom,msm8610-mtp", "qcom,msm8610", "qcom,mtp";
	qcom,board-id = <8 0>;
};


