/* Copyright (c) 2013, The Linux Foundation. All rights reserved.
 *
 * This program is free software; you can redistribute it and/or modify
 * it under the terms of the GNU General Public License version 2 and
 * only version 2 as published by the Free Software Foundation.
 *
 * This program is distributed in the hope that it will be useful,
 * but WITHOUT ANY WARRANTY; without even the implied warranty of
 * MERCHANTABILITY or FITNESS FOR A PARTICULAR PURPOSE.  See the
 * GNU General Public License for more details.
 */

/*---------------------------------------------------------------------------
 * This file is autogenerated file using gcdb parser. Please do not edit it.
 * Update input XML file to add a new entry or update variable in this file
 * VERSION = "1.0"
 *---------------------------------------------------------------------------*/
&mdss_mdp {
	dsi_truly_wvga_vid: qcom,mdss_dsi_truly_wvga_video {
		qcom,mdss-dsi-panel-name = "Truly WVGA video mode dsi panel";
		qcom,cont-splash-enabled;
		qcom,mdss-dsi-panel-controller = <&mdss_dsi0>;
		qcom,mdss-dsi-panel-type = "dsi_video_mode";
		qcom,mdss-dsi-panel-destination = "display_1";
		qcom,mdss-dsi-panel-mode-gpio-state = "high";
		qcom,mdss-dsi-panel-framerate = <60>;
		qcom,mdss-dsi-virtual-channel-id = <0>;
		qcom,mdss-dsi-stream = <0>;
		qcom,mdss-dsi-panel-width = <480>;
		qcom,mdss-dsi-panel-height = <800>;
		qcom,mdss-dsi-h-front-porch = <32>;
		qcom,mdss-dsi-h-back-porch = <32>;
		qcom,mdss-dsi-h-pulse-width = <32>;
		qcom,mdss-dsi-h-sync-skew = <0>;
		qcom,mdss-dsi-v-back-porch = <7>;
		qcom,mdss-dsi-v-front-porch = <7>;
		qcom,mdss-dsi-v-pulse-width = <3>;
		qcom,mdss-dsi-h-left-border = <0>;
		qcom,mdss-dsi-h-right-border = <0>;
		qcom,mdss-dsi-v-top-border = <0>;
		qcom,mdss-dsi-v-bottom-border = <0>;
		qcom,mdss-dsi-bpp = <24>;
		qcom,mdss-dsi-underflow-color = <0xff>;
		qcom,mdss-dsi-border-color = <0>;
		qcom,mdss-dsi-on-command = [
					39 01 00 00 00 00 04
						B9 FF 83 79
					39 01 00 00 00 00 03
						BA 51 93
					39 01 00 00 00 00 14
						B1 00 50 14
						EA D0 08 11
						10 70 27 2F
						9A 1A 22 0B
						4A F1 00 E6
					39 01 00 00 00 00 0E
						B2 00 00 3C
						0B 03 19 22
						00 FF 0B 03
						19 20
					39 01 00 00 00 00 20
					B4 80 08 00 32 10 01
					32 13 72 32 10 08 33
					08 28 03 37 08 3C 0C
					3E 3E 0C 00 40 08 28
						08 30 30 04
					39 01 00 00 00 00 30
						D5 00 00 0A
						00 01 00 00
						03 00 99 88
						AA BB 23 01
						67 45 01 23
						88 88 88 88
						88 88 88 99
						BB AA 54 76
						10 32 32 10
						88 88 88 88
						88 88 3c 01
						00 00 00 00
					39 01 00 00 00 00 24
						E0 79 00 01
						06 25 25 38
						2B 47 03 09
						11 15 17 15
						16 13 18 00
						01 06 25 25
						38 2B 47 03
						09 11 15 17
						15 16 13 18
						39 01 00 00
						00 00 02 cc
						0e
					39 01 00 00 00 00 05
						B6 00 B5 00 B5
					39 01 00 00 00 00 03
						C6 00 02
					39 01 00 00 00 00 04
						B9 00 83 79
					05 01 00 00 78 00 02
						11 00
					05 01 00 00 32 00 02
						29 00
					];
		qcom,mdss-dsi-off-command = [05 01 00 00 32 00 02 28 00
					05 01 00 00 78 00 02 10 00];
		qcom,mdss-dsi-esd-command = [
			39 01 00 00 05 00 03
				02 00 00
			39 01 00 00 05 00 03
				32 00 00
			39 01 00 00 05 00 03
				38 00 00
			39 01 00 00 05 00 03
				20 00 00
			39 01 00 00 05 00 03
				11 00 00
			39 01 00 00 05 00 03
				29 00 00
			];
		qcom,mdss-dsi-on-command-state = "dsi_lp_mode";
		qcom,mdss-dsi-off-command-state = "dsi_lp_mode";
		qcom,mdss-dsi-esd-state = "dsi_lp_mode";
		qcom,mdss-dsi-h-sync-pulse = <0>;
		qcom,mdss-dsi-traffic-mode = "non_burst_sync_event";
		qcom,mdss-dsi-lane-map = "lane_map_3012";
		qcom,mdss-dsi-bllp-eof-power-mode= <1>;
		qcom,mdss-dsi-bllp-power-mode= <1>;
		qcom,mdss-dsi-lane-0-state;
		qcom,mdss-dsi-lane-1-state;
		qcom,mdss-dsi-panel-timings = [A2 88 12 00 8E 92 16 8A 0E 03 04 00];
		qcom,mdss-dsi-t-clk-post = <0x04>;
		qcom,mdss-dsi-t-clk-pre = <0x18>;
		qcom,mdss-dsi-bl-min-level = <1>;
		qcom,mdss-dsi-bl-max-level = <255>;
		qcom,mdss-dsi-dma-trigger = "trigger_sw";
		qcom,mdss-dsi-mdp-trigger = "none";
		qcom,mdss-dsi-bl-pmic-control-type = "bl_ctrl_wled";
		qcom,mdss-dsi-reset-sequence = <1 20>, <0 2>, <1 20>;
		qcom,mdss-pan-physical-width-dimension = <52>;
		qcom,mdss-pan-physical-height-dimension = <86>;
	};
};
