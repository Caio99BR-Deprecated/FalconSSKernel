/* Copyright (c) 2013, The Linux Foundation. All rights reserved.
 *
 * This program is free software; you can redistribute it and/or modify
 * it under the terms of the GNU General Public License version 2 and
 * only version 2 as published by the Free Software Foundation.
 *
 * This program is distributed in the hope that it will be useful,
 * but WITHOUT ANY WARRANTY; without even the implied warranty of
 * MERCHANTABILITY or FITNESS FOR A PARTICULAR PURPOSE.  See the
 * GNU General Public License for more details.
 */

&soc {
	qcom,dsi_v2_hx8379a_wvga_video {
		compatible = "qcom,dsi-panel-v2";
		label = "HX8379A WVGA video mode dsi panel";
		qcom,dsi-ctrl-phandle = <&mdss_dsi0>;
		qcom,rst-gpio = <&msmgpio 41 0>;
		qcom,mode-selection-gpio = <&msmgpio 7 0>;
		qcom,hw-detect-gpio = <&msmgpio 78 0>;
		vdda-supply = <&pm8110_l19>;
		vddio-supply = <&pm8110_l14>;
		qcom,mdss-pan-res = <480 800>;
		qcom,mdss-pan-bpp = <24>;
		qcom,mdss-pan-dest = "display_1";
		qcom,mdss-pan-porch-values = <32 32 32 7 3 7>;
		qcom,mdss-pan-underflow-clr = <0xff>;
		qcom,mdss-pan-bl-levels = <1 255>;
		qcom,mdss-pan-bl-ctrl = "bl_ctrl_wled";
		qcom,mdss-pan-dsi-mode = <0>;
		qcom,mdss-pan-dsi-h-pulse-mode = <0>;
		qcom,mdss-pan-dsi-h-power-stop = <0 0 0>;
		qcom,mdss-pan-dsi-bllp-power-stop = <1 1>;
		qcom,mdss-pan-dsi-traffic-mode = <1>;
		qcom,mdss-pan-dsi-dst-format = <3>;
		qcom,mdss-pan-dsi-vc = <0>;
		qcom,mdss-pan-dsi-rgb-swap = <0>;
		qcom,mdss-pan-dsi-data-lanes = <1 1 0 0>;
		qcom,mdss-pan-dsi-dlane-swap = <1>;
		qcom,mdss-pan-dsi-t-clk = <0x18 0x04>;
		qcom,mdss-pan-dsi-stream = <0>;
		qcom,mdss-pan-dsi-mdp-tr = <0x0>;/*todo*/
		qcom,mdss-pan-dsi-dma-tr = <0x04>;
		qcom,mdss-pan-dsi-frame-rate = <60>;
		qcom,panel-phy-regulatorSettings =[02 08 05 00 20 03];
		qcom,panel-phy-timingSettings = [A2 88 12 00 8E 92
						16 8A 0E 03 04 00];
		qcom,panel-phy-strengthCtrl = [ff 06];
		qcom,panel-phy-bistCtrl = [03 03 00 00 0f 00];
		qcom,panel-phy-laneConfig =
					[80 45 00 00 01 66 /*lane0**/
					80 45 00 00 01 66 /*lane1*/
					80 45 00 00 01 66 /*lane2*/
					80 45 00 00 01 66 /*lane3*/
					40 67 00 00 01 88]; /*Clk*/

		qcom,on-cmds-dsi-state = "DSI_LP_MODE";
		qcom,panel-on-cmds = [
					39 01 00 00 00 04
						B9 ff 83 79
					39 01 00 00 00 03
						BA 51 93
					39 01 00 00 00 20
						B1 00 50 24
						EA 90 08 11
						11 71 2F 37
						9A 1A 22 1B
						6E F1 00 E6
						E6 E6 E6 E6
						00 04 05 0A
						0B 04 05 6F
					39 01 00 00 00 0E
						B2 00 00 3c
						08 12 19 22
						00 FF 08 0C
						19 20
					39 01 00 00 00 20
						B4 80 00 00
						32 10 03 32
						13 29 32 10
						08 35 01 28
						07 37 00 30
						08 36 36 04
						00 40 08 28
						08 30 30 04
					39 01 00 00 00 30
						D5 00 00 0A
						00 01 05 00
						00 18 88 99
						88 01 45 88
						88 01 45 23
						67 88 88 88
						88 88 88 88
						99 54 10 88
						88 76 32 54
						10 88 88 88
						88 88 00 00
						00 00 00 00
					39 01 00 00 00 04
						DE 05 70 04
					39 01 00 00 00 24
						E0 79 07 12
						14 32 34 3F
						42 53 06 12
						10 14 16 14
						15 11 14 07
						12 14 32 34
						3F 42 53 06
						12 10 14 16
						14 15 11 14
					15 01 00 00 00 02
						cc 0e
					39 01 00 00 00 05
						B6 00 87 00 87
					05 01 00 00 78 02
						11 00
					05 01 00 00 32 02
						29 00
					];
		qcom,tcl-panel-on-cmds = [
					39 01 00 00 00 04
						b9 ff 83 79
					39 01 00 00 00 02
						ba 51
					39 01 00 00 00 14
						B1 00 50 24
						EA D1 08 11
						10 F0 27 2F
						9A 1A
					42 0B 76 F1 00 E6
					39 01 00 00 00 0E
						B2 00 00 3c
						0B 03 19 22
						00 FF 0B 03
						19 22
					39 01 00 00 00 20
						B4 82 08 00
						32 10 01 32
						13 72 32 10
						08 33 08 28
						03 37 08 3C
						08 3E 3E 08
						00 40 08 28
						08 30 30 04
					39 01 00 00 00 30
						D5 00 00 0A
						00 01 00 00
						03 00 99 88
						AA BB 23 01
						67 45 01 23
						88 88 88 88
						88 88 88 99
						BB AA 54 76
						10 32 32 10
						88 88 88 88
						88 88
					01 01 00 00 00 00
					39 01 00 00 00 24
						E0 79 00 00
						06 27 28 38
						2F 48 08 0F
						11 14 17 15
						16 14 18 00
						00 06 27 28
						38 2F 48 08
						0F 11 14 17
						15 16 14 18
					15 01 00 00 00 02
						cc 0e
					39 01 00 00 00 05
						B6 00 9F 00 9F
					05 01 00 00 78 02
						11 00
					05 01 00 00 32 02
						29 00
					];
		qcom,truly-panel-on-cmds = [
					39 01 00 00 00 04
						B9 FF 83 79
					39 01 00 00 00 03
						BA 51 93
					39 01 00 00 00 14
						B1 00 50 14
						EA D0 08 11
						10 70 27 2F
						9A 1A
					22 0B 4A F1 00 E6
					39 01 00 00 00 0E
						B2 00 00 3C
						0B 03 19 22
						00 FF 0B 03
						19 20
					39 01 00 00 00 20
						B4 80 08 00
						32 10 01 32
						13 72 32 10
						08 33 08 28
						03 37 08 3C
						0C 3E 3E 0C
						00 40 08 28
						08 30 30 04
					39 01 00 00 00 30
						D5 00 00 0A
						00 01 00 00
						03 00 99 88
						AA BB 23 01
						67 45 01 23
						88 88 88 88
						88 88 88 99
						BB AA 54 76
						10 32 32 10
						88 88 88 88
						88 88
					3c 01 00 00 00 00
					39 01 00 00 00 24
						E0 79 00 03
						0F 24 25 3F
						31 47 08 10
						11 15 17 15
						15 12 17 00
						03 0F 24 25
						3F 31 47 08
						10 11 15 17
						15 15 12 17
						39 01 00 00
						00 02 cc 0e
					39 01 00 00 00 05
						B6 00 B5 00 B5
					05 01 00 00 78 02
						11 00
					05 01 00 00 32 02
						29 00
					];
		qcom,panel-off-cmds = [05 01 00 00 32 02 28 00
					05 01 00 00 78 02 10 00];
		qcom,off-cmds-dsi-state = "DSI_LP_MODE";
	};
};
